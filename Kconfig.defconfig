## Kconfig.defconfig
```kconfig
if SHIELD_HOLYIOT_18010_NRF52840_83

config ZMK_KEYBOARD_NAME
    default "holyiot_18010_nrf52840_83"

endif
```

## Kconfig.shield
```kconfig
# Copyright (c) 2020 Pete Johanson
# SPDX-License-Identifier: MIT

config SHIELD_HOLYIOT_18010_NRF52840_83
    def_bool $(shields_list_contains,holyiot_18010_nrf52840_83)
```

## config/Kconfig.board
```kconfig
# Copyright (c) 2023 Nordic Semiconductor ASA
# SPDX-License-Identifier: Apache-2.0

config BOARD_HOLYIOT18010
	bool "holyiot18010"
	depends on SOC_NRF52840_QIAA
```

## config/Kconfig.defconfig
```kconfig
# Copyright (c) 2023 Nordic Semiconductor ASA
# SPDX-License-Identifier: Apache-2.0

if BOARD_HOLYIOT18010

config ZMK_KEYBOARD_NAME
	default "holyiot18010"

# if USB_DEVICE_STACK

# config USB_NRFX
#    default y

# endif # USB_DEVICE_STACK

config BT_CTLR
   default BT

# config ZMK_BLE
#    default n

config ZMK_USB
   default y

config ZMK_KSCAN_MATRIX_POLLING
    default y

endif
```

## config/boards/shields/Kconfig.defconfig
```kconfig
if SHIELD_HOLYIOT_18010_NRF52840_83
# holyiot_18010_nrf52840_83
config ZMK_KEYBOARD_NAME
    default "per83"

endif
```

## config/boards/shields/Kconfig.shield
```kconfig
# Copyright (c) 2020 Pete Johanson
# SPDX-License-Identifier: MIT

config SHIELD_PER83
    def_bool $(shields_list_contains,per83)
```

## config/holyiot18010_defconfig
```kconfig
# Copyright (c) 2023 Nordic Semiconductor ASA
# SPDX-License-Identifier: Apache-2.0

CONFIG_SOC_SERIES_NRF52X=y
CONFIG_SOC_NRF52840_QIAA=y
CONFIG_BOARD_HOLYIOT18010=y

# Enable MPU
CONFIG_ARM_MPU=y

# enable GPIO
CONFIG_GPIO=y

# Enable hardware stack protection
# CONFIG_HW_STACK_PROTECTION=y

CONFIG_USE_DT_CODE_PARTITION=y
CONFIG_BUILD_OUTPUT_UF2=y

CONFIG_MPU_ALLOW_FLASH_WRITE=y
CONFIG_NVS=y
CONFIG_SETTINGS_NVS=y
CONFIG_FLASH=y
CONFIG_FLASH_PAGE_LAYOUT=y
CONFIG_FLASH_MAP=y
```
