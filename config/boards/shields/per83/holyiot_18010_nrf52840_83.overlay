#include <dt-bindings/zmk/matrix_transform.h>

/ {
    chosen {
        zmk,kscan = &kscan0;
    };

    kscan0: kscan_0 {
        compatible = "zmk,kscan-gpio-matrix";
        label = "KSCAN";
        diode-direction = "col2row";
        debounce-press-ms = 5;

        col-gpios = <&gpio1 11 GPIO_ACTIVE_HIGH>
            , <&gpio1 10 GPIO_ACTIVE_HIGH>
            , <&gpio1 13 GPIO_ACTIVE_HIGH>
            , <&gpio1 15 GPIO_ACTIVE_HIGH>
            , <&gpio0 3 GPIO_ACTIVE_HIGH>
            , <&gpio0 2 GPIO_ACTIVE_HIGH>
            , <&gpio0 28 GPIO_ACTIVE_HIGH>
            , <&gpio0 29 GPIO_ACTIVE_HIGH>
            , <&gpio0 30 GPIO_ACTIVE_HIGH>
            , <&gpio0 31 GPIO_ACTIVE_HIGH>
            , <&gpio0 4 GPIO_ACTIVE_HIGH>
            , <&gpio0 5 GPIO_ACTIVE_HIGH>
            , <&gpio0 7 GPIO_ACTIVE_HIGH>
            , <&gpio1 9 GPIO_ACTIVE_HIGH>
            , <&gpio0 12 GPIO_ACTIVE_HIGH>
            ;
        
        row-gpios = <&gpio0 19 (GPIO_ACTIVE_HIGH | GPIO_PUUL_DOWN)>
            , <&gpio0 22 (GPIO_ACTIVE_HIGH | GPIO_PUUL_DOWN)>
            , <&gpio1 0 (GPIO_ACTIVE_HIGH | GPIO_PUUL_DOWN)>
            , <&gpio1 3 (GPIO_ACTIVE_HIGH | GPIO_PUUL_DOWN)>
            , <&gpio1 1 (GPIO_ACTIVE_HIGH | GPIO_PUUL_DOWN)>
            , <&gpio1 2 (GPIO_ACTIVE_HIGH | GPIO_PUUL_DOWN)>
    };
};